## conf/layer.conf
```bitbake
# We have a conf and classes directory, append to BBPATH
BBPATH .= ":${LAYERDIR}"

# We have a recipes directory, add to BBFILES
BBFILES += "${LAYERDIR}/recipes*/*/*.bb ${LAYERDIR}/recipes*/*/*.bbappend"

BBFILE_COLLECTIONS += "openamp-xilinx-layer"
BBFILE_PATTERN_openamp-xilinx-layer := "^${LAYERDIR}/"
BBFILE_PRIORITY_openamp-xililnx-layer = "4"
```
